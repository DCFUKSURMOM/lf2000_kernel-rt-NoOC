## arch/arm/mach-nxp3200/Kconfig
```kconfig
#
# Copyright 2010 Nexell.
#
# Configuration options for the Nexell CPU

config ARCH_NEXELL
	bool
	default y

config PLAT_NXP3200
	bool
	default y

choice
    prompt "Platform board"
    depends on ARCH_NXP3200
    default PLAT_NXP3200_M2K

	config PLAT_NXP3200_BID
		bool "Leapfrog Board with valid ID"
		help
			Support for the LeapFrog LF2000 with functioning Board ID

	config PLAT_NXP3200_FAVELA
		bool "LeapFrog LeapPad running the Rio UI"
		help
			Support for the LeapFrog LeapPad running the 'Rio' UI

	config PLAT_NXP3200_L2K
		bool "LeapFrog Explorer 'Lucy' LF2000 Board"
		help
   	 		Support for the LeapFrog Explorer 'Lucy' LF2000 form-factor Board

	config PLAT_NXP3200_RIO
		bool "LeapFrog 'Rio' LF2000 Board"
		help
   	 		Support for the LeapFrog LeapPad 'Rio' LF2000 form-factor Board

	
	config PLAT_NXP3200_M2K
		bool "LeapFrog LeapPad 'Valencia' LF2000 Board"
		help
   	 		Support for the LeapFrog LeapPad 'Valencia' LF2000 form-factor Board
   	 		
   	config PLAT_NXP3200_VALENCIA_CIP
		bool "Leapfrog LeapPad 'Valencia CIP' LF2000 Board"
		help
   	 		Support for the LeapFrog LeapPad 'Valencia CIP' LF2000 form-factor Board

	config PLAT_NXP3200_VTK
		bool "VTK: Validation Test Kit"
		help
   	 		Support for the validation test kit(vtk) board.
endchoice

choice
	prompt "Prototype build mode"
   	depends on ARCH_NXP3200
	default PROTOTYPE_NXP3200_DBG

	config  PROTOTYPE_NXP3200_REL
		bool "Release"

	config  PROTOTYPE_NXP3200_DBG
		bool "Debug"
endchoice

config  NXP3200_SURGEON
	prompt "Surgeon Build"
    	depends on ARCH_NXP3200
	bool
	default n
        ---help---
        This option enables the surgeon recovery system build.
        If you are unsure, say N.

choice
	prompt "memory max order"
    	depends on ARCH_NXP3200
 	default MAX_ORDER_11

	config MAX_ORDER_11
		bool "4Mbyte"
	config MAX_ORDER_12
		bool "8Mbyte"
endchoice

config FORCE_MAX_ZONEORDER
   	int
   	default 11 if MAX_ORDER_11
   	default 12 if MAX_ORDER_12

choice
	prompt "PLL1 speed"
	default 550_PLL1_147P5_MHZ

	config 550_PLL1_147P5_MHZ
		bool "147.5 MHz"

	config PLL1_266_MHZ
		bool "266 MHz"

	config PLL1_275_MHZ
		bool "275 MHz"

	config PLL1_333_MHZ
		bool "333 MHz"

	config PLL1_400_MHZ
		bool "400 MHz"
endchoice

config SOC_LFP100
	tristate "Support for the LFP100 audio/power/backlight chip"
	depends on !PLAT_NXP3200_VTK
	default y
	---help---
	This option enables platform support for the LFP100 combination
	chip.  It is checked at runtime.  If you are unsure, say Y.
```

## drivers/video/nexell/Kconfig
```kconfig
#
# Copyright 2010 Nexell.
#
# Configuration options for the Nexell Display SoC

comment "Nexell Graphic"
source "drivers/video/nexell/vmem/Kconfig"
source "drivers/video/nexell/dpc/Kconfig"
source "drivers/video/nexell/lcd/Kconfig"
source "drivers/video/nexell/vip/Kconfig"
source "drivers/video/nexell/decoder/Kconfig"
source "drivers/video/nexell/csc/Kconfig"
source "drivers/video/nexell/rotator/Kconfig"
```

## drivers/video/nexell/csc/Kconfig
```kconfig
#
# Portions Copyright 2010 Nexell.
#
# Configuration options for the LF2000 CSC (Color Space Converter)

config GRP_LF2000_CSC
	tristate "CSC (Color Space Converter) for LF2000"
	depends on ARCH_NEXELL
	help
		Device driver access to LF2000 CSC register group.
		
```

## drivers/video/nexell/decoder/Kconfig
```kconfig
#
# Copyright 2010 Nexell.
#
# Configuration options for the Nexell Video Decoder
################################################################################
config VIP_DECODER_SR300PC10
	tristate "SR300PC10 video decoder for VIP"
	depends on GRP_NEXELL_VIP

	config SR300PC10_I2C_PORT
		int "Connect to i2c port num"
		depends on VIP_DECODER_SR300PC10
			default 0

	config SR300PC10_VIP_PORT
		int "Connect to vip port num"
		depends on VIP_DECODER_SR300PC10
			default 0
```

## drivers/video/nexell/dpc/Kconfig
```kconfig
#
# Copyright 2010 Nexell.
#
# Configuration options for the Nexell display controller

config GRP_NEXELL_DPC
	bool "Display controller for Nexell"
	depends on ARCH_NEXELL
```

## drivers/video/nexell/lcd/Kconfig
```kconfig
#
# Copyright 2010 Nexell.
#
# Configuration options for the Nexell LCD

config NXP3200_LCD_VTK
	bool "Backlight & Lcd for nxp3200 vtk board"
	depends on FB_NEXELL
	depends on PLAT_NXP3200
```

## drivers/video/nexell/rotator/Kconfig
```kconfig
#
# Portions Copyright 2010 Nexell.
#
# Configuration options for the LF2000 ROTATOR (Rotator)

config GRP_LF2000_ROTATOR
	tristate "ROTATOR (Rotator) for LF2000"
	depends on ARCH_NEXELL
	help
		Device driver access to LF2000 ROTATOR register group.
		
```

## drivers/video/nexell/vip/Kconfig
```kconfig
#
# Copyright 2010 Nexell.
#
# Configuration options for the Nexell VIP (Video Input Processor)

config GRP_NEXELL_VIP
	tristate "VIP (Video Input Processor) for Nexell"
	depends on ARCH_NEXELL

config GRP_NEXELL_VIP_MODULE0
	bool "VIP module 0"
	depends on GRP_NEXELL_VIP
		default y
```

## drivers/video/nexell/vmem/Kconfig
```kconfig
#
# Copyright 2010 Nexell.
#
# Configuration options for the Nexell Memory Allocator

config GRP_NEXELL_VMEM
	bool "Memory allocator for graphic devices"
	depends on ARCH_NEXELL

config GRP_NEXELL_VMEM_ALLOC_DMA_MAX
	int "Max allocate size from dma zone"
	depends on GRP_NEXELL_VMEM
		default 0

config GRP_NEXELL_VMEM_KILLER
	bool "Video Memory Killer"
	depends on GRP_NEXELL_VMEM
		default n

config GRP_NEXELL_VMEM_KILL_LIST_OGL
	bool "Get kill task list from OGL"
	depends on GRP_NEXELL_VMEM && GRP_NEXELL_VMEM_KILLER
		default n
```

## sound/soc/nexell/Kconfig
```kconfig
#
# Copyright 2010 Nexell.
#
# Configuration options for the Nexell Sound

config SND_NEXELL_SOC
	tristate "Nexell SoC Audio (NX series)"
	depends on ARCH_NEXELL
	help
	  Say Y or M if you want to add support for codecs attached to
	  the AC97 and I2S interface.

config SND_NEXELL_SOC_I2S
	tristate

config SND_NEXELL_SOC_AC97
	tristate

config SND_CODEC_CS42L52
	tristate "cs42l52 I2S audio codec."
	depends on SND_NEXELL_SOC
	select SND_NEXELL_SOC_I2S
	select SND_SOC_CS42L52

config SND_CODEC_LFP100
	tristate "LFP100 I2S audio codec"
	depends on SND_NEXELL_SOC
	select SND_NEXELL_SOC_I2S
	select SND_SOC_LFP100
	help
	  Say Y or M to enable SoC support for LFP100 audio codec. 
	  If unsure, say M.
```
